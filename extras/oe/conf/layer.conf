## extras/oe/conf/layer.conf
```bitbake
# We have a conf and classes directory, add to BBPATH
BBPATH .= ":${LAYERDIR}"

# We have recipes-* directories, add to BBFILES
BBFILES += "${LAYERDIR}/recipes-*/*/*.bb \
            ${LAYERDIR}/recipes-*/*/*.bbappend"

BBFILE_COLLECTIONS += "meta-vpp"
BBFILE_PATTERN_meta-vpp = "^${LAYERDIR}/"
BBFILE_PRIORITY_meta-vpp = "6"

LAYERDEPENDS_meta-vpp = "core dpdk"
LAYERSERIES_COMPAT_meta-vpp = "scarthgap"
```
